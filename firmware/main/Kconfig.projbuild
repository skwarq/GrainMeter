## firmware/main/Kconfig.projbuild
```kconfig
menu "GrainMeter"

    config GM_ONEWIRE_GPIO
        int "1-Wire DATA GPIO"
        range 0 23
        default 3
        help
            GPIO for the probe DATA line (Hirschmann CA 3 GD pin 2, red).
            Default GPIO3 = pin "3" (back: "3/A2"), 8th from the battery connector:
            not a strapping pin, not used on the board. Avoid GPIO4/5/8/9/15
            (strapping), 12/13 (USB), 16/17 (UART0) and GPIO0 (battery ADC).
            External 4.7 kOhm pull-up to 3V3 is required.

    config GM_ONEWIRE_INTERNAL_PULLUP
        bool "Also enable the weak internal pull-up on DATA"
        default y

    config GM_SERVICE_BUTTON_GPIO
        int "Service mode button GPIO"
        range 0 23
        default 9
        help
            Default GPIO9 = BOOT button. Holding BOOT while resetting selects
            the ROM download mode, so the firmware only samples it AFTER it
            started: press RST, release, then press BOOT within the window.

    config GM_SERVICE_WAKE_GPIO
        int "Service button that wakes from deep sleep (LP GPIO, -1 = none)"
        range -1 7
        default 2
        help
            Button between this GPIO and GND opens the service portal straight
            from deep sleep (EXT1 wake-up) without a reset, so the samples
            waiting in RTC memory are kept. Only LP GPIO0..7 can wake the
            ESP32-C6. Default GPIO2 = pin "2" (back: "2/A1"), 9th from the
            battery connector (free on the board, not a strapping pin). Add an external 10 kOhm pull-up to 3V3
            (the internal one is enabled too).

    config GM_SERVICE_BUTTON_WINDOW_MS
        int "Window after power-on/reset to press the service button (ms)"
        default 3000

    config GM_SERVICE_TIMEOUT_S
        int "Leave service mode after this many idle seconds"
        default 600

    config GM_LED_GPIO
        int "Status LED GPIO (-1 = none)"
        range -1 23
        default 15

    config GM_BATTERY_ADC
        bool "Measure battery voltage"
        default y
        help
            FireBeetle 2 ESP32-C6 V1.0/V1.1: VBAT -> R15 1M / R16 1M -> GPIO0
            (ADC1 channel 0), 100 nF to GND.

    config GM_BATTERY_GPIO
        int "Battery ADC GPIO"
        depends on GM_BATTERY_ADC
        default 0

    config GM_BATTERY_DIVIDER_X1000
        int "Battery divider ratio x1000 (VBAT / VADC)"
        depends on GM_BATTERY_ADC
        default 2000

    config GM_AP_CHANNEL
        int "SoftAP channel"
        range 1 13
        default 1

    config GM_SERVICE_AP_OPEN
        bool "Open service access point (no Wi-Fi password)"
        default y
        help
            Like WIFI_RS: the SoftAP has no password, so phones join it
            directly and show the captive portal. Changes, OTA and actions
            in the portal still need the service password. Disable for a
            WPA2 SoftAP protected by the service password.

    config GM_TIMEZONE
        string "Time zone for log timestamps (POSIX TZ)"
        default "CET-1CEST,M3.5.0,M10.5.0/3"
        help
            Log lines show the local wall-clock time HH:MM:SS.sss once the
            clock is set (SNTP). Data sent to ThingSpeak stays in UTC.

    config GM_DEFAULT_UPDATE_URL
        string "Default remote update manifest URL (empty = off)"
        default ""
        help
            Used until another update_url is stored. The signed release
            profile (sdkconfig.signed) points it at the GitHub "latest"
            release manifest, so released devices update themselves.

    config GM_DEFAULT_SERVICE_PASSWORD
        string "Service password used when none is stored (empty = require USB setup)"
        default ""
        help
            Leave empty in the repository. Set it only in a local sdkconfig
            if devices must start with a known password.

endmenu
```

## tools/ow_emulator/main/Kconfig.projbuild
```kconfig
# SPDX-License-Identifier: MIT
menu "OW emulator"
config OW_SLAVE_GPIO
    int "STW-100 DATA GPIO (open drain)"
    range 0 30
    default 3
config OW_INTERNAL_PULLUP
    bool "Internal pull-up on DATA (diode level shifter to a 5 V bus)"
    default y
    help
        Wiring: STW-100 DATA (anode) -|>|- GPIO (cathode); best with an extra
        4.7..10 kOhm resistor from GPIO to 3V3. Disable for a direct 3.3 V bus
        or a BSS138 module, which has its own pull-ups.
config OW_AP_PASSWORD
    string "SoftAP password (empty or 8..63 characters)"
    default ""
config OW_REAL_SENSOR
    bool "Enable separate DS18B20 master"
    default n
config OW_MASTER_GPIO
    int "Real DS18B20 DATA GPIO (external 3.3 V pull-up)"
    range 0 30
    default 6
endmenu
```

## tools/ow_emulator/sdkconfig.defaults
```kconfig
# SPDX-License-Identifier: MIT
CONFIG_IDF_TARGET="esp32c6"
CONFIG_ESP_DEFAULT_CPU_FREQ_MHZ_160=y
CONFIG_COMPILER_OPTIMIZATION_PERF=y
CONFIG_COMPILER_CXX_EXCEPTIONS=n
CONFIG_COMPILER_CXX_RTTI=n
CONFIG_FREERTOS_HZ=1000
CONFIG_ESP_TASK_WDT_TIMEOUT_S=5
CONFIG_GPIO_CTRL_FUNC_IN_IRAM=y
CONFIG_ESP_WIFI_IRAM_OPT=y
CONFIG_ESP_WIFI_RX_IRAM_OPT=y
CONFIG_PARTITION_TABLE_SINGLE_APP_LARGE=y
```

## tools/ow_sniffer/main/Kconfig.projbuild
```kconfig
# SPDX-License-Identifier: MIT
menu "OW Sniffer"
    config OW_DATA_GPIO
        int "Passive DATA input GPIO (never driven)"
        range 0 14
        default 3
        help
            Choose a free, exposed GPIO. GPIO15 is reserved for the activity LED.
            Avoid USB, flash and boot strapping pins on your board.
    config OW_INTERNAL_PULLUP
        bool "Internal pull-up on DATA (diode level shifter to a 5 V bus)"
        default y
        help
            Wiring: STW-100 DATA (anode) -|>|- GPIO (cathode); best with an
            extra 4.7..10 kOhm resistor from GPIO to 3V3. Disable for a
            resistor divider, a direct 3.3 V bus or a BSS138 module.
    config OW_AP_PASSWORD
        string "SoftAP password (empty = open; otherwise 8 to 63 characters)"
        default ""
endmenu
```

## tools/ow_sniffer/sdkconfig.defaults
```kconfig
# SPDX-License-Identifier: MIT
CONFIG_IDF_TARGET="esp32c6"
CONFIG_COMPILER_CXX_EXCEPTIONS=n
CONFIG_COMPILER_OPTIMIZATION_SIZE=y
CONFIG_ESPTOOLPY_FLASHSIZE_4MB=y
CONFIG_GPIO_CTRL_FUNC_IN_IRAM=y
CONFIG_ESP_WIFI_IRAM_OPT=y
CONFIG_ESP_WIFI_RX_IRAM_OPT=y
CONFIG_ESP_DEFAULT_CPU_FREQ_MHZ_160=y
CONFIG_PM_ENABLE=n
```
